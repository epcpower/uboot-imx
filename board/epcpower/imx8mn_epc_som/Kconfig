## board/epcpower/imx8mn_epc_som/Kconfig
```kconfig
if TARGET_IMX8MN_EPC_SOM

config SYS_BOARD
	default "imx8mn_epc_som"

config SYS_VENDOR
	default "epcpower"

config SYS_CONFIG_NAME
	default "imx8mn_epc_som"

config IMX8MN_LOW_DRIVE_MODE
	bool "Enable the low drive mode of iMX8MN on SOM board"

config IMX_CONFIG
	default "board/epcpower/imx8mn_epc_som/imximage-8mn-ddr4.cfg"

endif
```

## board/epcpower/imx8mp_epc_tau/Kconfig
```kconfig
if TARGET_IMX8MP_EPC_TAU

config SYS_BOARD
	default "imx8mp_epc_tau"

config SYS_VENDOR
	default "epcpower"

config SYS_CONFIG_NAME
	default "imx8mp_epc_tau"

config IMX_CONFIG
	default "board/epcpower/imx8mp_epc_tau/imximage-8mp-lpddr4.cfg"

endif
```
